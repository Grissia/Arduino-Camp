#include <Adafruit_GFX.h>
#include <Adafruit_GrayOLED.h>
#include <Adafruit_SPITFT.h>
#include <Adafruit_SPITFT_Macros.h>
#include <gfxfont.h>

#include <Adafruit_SSD1306.h>
#include <splash.h>

#include <DHT.h>
#include <DHT_U.h>

#include <IRremote.h>
#include <IRremoteInt.h>

int IRPin = A0;
IRrecv IR(IRPin);
decode_results results;
int BLED = 11;
int BLevel = 20;
int KG = 4;

bool dist_flag = false;
float distance = NULL;

DHT dhtr(2,DHT11);
int Trig = 7;
int Echo = 8;
int swPin = 3;

int Height = 64, Width = 128, Reset = -1;
int x = 5, y = 10;
Adafruit_SSD1306 oled(Width, Height, &Wire, Reset);

int Buzzer = 10;
int Do = 262, Do_ = 272, Re = 294, Re_ = 311, Mi = 330;
int Fa = 349, Fa_ = 370, Sol = 392, Sol_ = 415, La = 440, La_ = 466, Si = 494;
int NLevel = 1;

const unsigned char site_01 [] PROGMEM = {
	0x00, 0x00, 0x00, 0x00, 0x00, 0x00, 0x00, 0x1f, 0xf8, 0x00, 0x00, 0x00, 0x00, 0x00, 0x00, 0x00, 
	0x00, 0x00, 0x00, 0x00, 0x00, 0x00, 0x01, 0xff, 0xff, 0xc0, 0x00, 0x00, 0x00, 0x00, 0x00, 0x00, 
	0x00, 0x00, 0x00, 0x00, 0x00, 0x00, 0x0f, 0xff, 0xff, 0xf0, 0x00, 0x00, 0x00, 0x00, 0x00, 0x00, 
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	0x00, 0x00, 0x00, 0x00, 0x00, 0x00, 0x00, 0x7f, 0xfe, 0x00, 0x00, 0x00, 0x00, 0x00, 0x00, 0x00
};
/*
void kingsman(){
  oled.clearDisplay();
  oled.drawCircle(64, 32, 25, 1);
  oled.drawLine(41, 41, 88, 41, 1);
  oled.drawLine(41, 22, 64, 41, 1);
  oled.drawLine(87, 22, 64, 41, 1);
  oled.display();
}
*/
const unsigned char kingsman [] PROGMEM = {
	0x00, 0x00, 0x00, 0x00, 0x00, 0x00, 0x00, 0x00, 0x00, 0x00, 0x00, 0x00, 0x00, 0x00, 0x00, 0x00, 
	0x00, 0x00, 0x00, 0x00, 0x00, 0x00, 0x00, 0x00, 0x00, 0x00, 0x00, 0x00, 0x00, 0x00, 0x00, 0x00, 
	0x00, 0x00, 0x00, 0x00, 0x00, 0x00, 0x00, 0x00, 0x00, 0x00, 0x00, 0x00, 0x00, 0x00, 0x00, 0x00, 
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	0x00, 0x00, 0x00, 0x00, 0x00, 0x00, 0x00, 0x00, 0x00, 0x00, 0x00, 0x00, 0x00, 0x00, 0x00, 0x00
};


void dist(int t){
  float v = (331+0.6*t)*100/1000000;
  digitalWrite(Trig, HIGH);
  delay(5);
  digitalWrite(Trig, LOW);
  float echotime = pulseIn(Echo, HIGH);
  float tmp = v*echotime/2;
  if(tmp < 4 || tmp > 400){
    return;
  }
  distance = tmp;
  dist_flag = true;
}
void setup() {
  Serial.begin(9600);
  dhtr.begin();
  oled.begin(SSD1306_SWITCHCAPVCC, 0x3C);

  IR.enableIRIn();
  pinMode(BLED, OUTPUT);
  
  oled.setTextSize(1);
  oled.setTextColor(WHITE);
  pinMode(Trig, OUTPUT);
  pinMode(Echo, INPUT);
  pinMode(swPin, INPUT);
  pinMode(Buzzer, OUTPUT);

  oled.clearDisplay();
  oled.drawBitmap(0,0,kingsman,128,64,1);
  oled.display(); 
  
  delay(2000);

  shuffle();

  oled.clearDisplay();

  agent();
  delay(2000);
  oled.clearDisplay();

  access();
  delay(2000);
  oled.clearDisplay();

  press();
  while(!digitalRead(swPin)){
    ;
  }
}

void loop() {
  
  int h = dhtr.readHumidity();
  float t = dhtr.readTemperature();
  
  if(digitalRead(swPin)==1){
    dist(t);
  }
  if(IR.decode(&results)){
    if(results.value==0xFFA25D){// 1
      analogWrite(BLED, 20);
    }
    if(results.value==0xFF629D){// 2
      analogWrite(BLED, 0);
    }
    if(results.value==0xFF38C7){// ok
      dist(t);
    }
    if(results.value==0xFF18E7){// up
      BLevel += KG;
      if(BLevel > 255){
        BLevel = 255;
      }
      analogWrite(BLED, BLevel);
    }
    if(results.value==0xFF4AB5){// down
      BLevel -= KG;
      if(BLevel < 0){
        BLevel = 0;
      }
      analogWrite(BLED, BLevel);
    }
    if(results.value==0xFF10EF){// left
      NLevel -= 1;
    }
    if(results.value==0xFF5AA5){// right
      NLevel += 1;
    }
    if(results.value==0xFF6897){// *
      oled.clearDisplay();
      oled.drawBitmap(0,0,kingsman,128,64,1);
      oled.display();
      delay(10000);
    }
    if(results.value==0xFFB04F){// #
      oled.clearDisplay();
      oled.drawBitmap(0,0,site_01,128,64,1);
      oled.display();
      delay(10000);
    }
    if(results.value==0xFF22DD){// 4
      tone(Buzzer, Do*NLevel, 500);
    }
    if(results.value==0xFF02FD){// 5
      tone(Buzzer, Re*NLevel, 500);
    }
    if(results.value==0xFFC23D){// 6
      tone(Buzzer, Mi*NLevel, 500);
    }
    if(results.value==0xFFE01F){// 7
      tone(Buzzer, Fa*NLevel, 500);
    }
    if(results.value==0xFFA857){// 8
      tone(Buzzer, Sol*NLevel, 500);
    }
    if(results.value==0xFF906F){// 9
      tone(Buzzer, La*NLevel, 500);
    }
    if(results.value==0xFF9867){// 0
      tone(Buzzer, Si*NLevel, 500);
    }
    IR.resume();
  }
  oled.clearDisplay();
  oled.setCursor(0,0);
  oled.print("Humid:");
  oled.print(h,1);
  oled.print("%");
  oled.print('\n');

  oled.print("Temp:");
  oled.print(t,1);
  oled.print('\n');

  if(dist_flag){
    oled.print("Dist:");
    oled.print(distance,1);
    oled.print('\n');
  }

  oled.display();
}
